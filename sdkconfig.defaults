## sdkconfig.defaults
```kconfig
# Partition Table
CONFIG_PARTITION_TABLE_DEFAULT=y
CONFIG_PARTITION_TABLE_TWO_OTA=y

# WiFi Configuration
CONFIG_ESP_WIFI_MODE_AP=n
CONFIG_ESP_WIFI_MODE_STA=y

# RainMaker Configuration
CONFIG_ESP_RMAKER_ENABLE_OTA=y
CONFIG_ESP_RMAKER_OTA_AUTOREBOOT=y
CONFIG_ESP_RMAKER_TIME_SYNC_ENABLED=y

# Logging
CONFIG_LOG_DEFAULT_LEVEL=3
CONFIG_LOG_DEFAULT_LEVEL_INFO=y

# ESP32-C3 Specific
CONFIG_IDF_TARGET_ESP32C3=y
CONFIG_ESP32C3_REV_MIN=0

# UART Configuration
CONFIG_UART_ISR_IN_IRAM=y

# Security
CONFIG_ESP_TLS_INSECURE=n
CONFIG_ESP_TLS_SKIP_SERVER_CERT_VERIFY=n

# Memory
CONFIG_ESP_HEAP_MEMORY_PROTECTION_ALL=y
```
